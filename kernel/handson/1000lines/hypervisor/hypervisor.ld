/*
 * hypervisor.ld - Hypervisor链接器脚本
 * 
 * 该脚本定义了hypervisor在内存中的布局结构，包括各个段的放置位置和内存分配。
 * 这对于操作系统或hypervisor这类需要精确控制内存布局的系统级程序非常重要。
 *
 * 分段的确定依据：
 * 1. ELF文件格式标准：
 *    ELF（Executable and Linkable Format）是Unix系统标准的二进制格式，定义了可执行文件、
 *    目标代码和共享库的结构。链接器根据ELF格式标准来组织和管理各个段。
 *
 * 2. 程序运行需求：
 *    根据程序的不同需求（如代码执行、数据读写、内存初始化等）来划分不同的段，
 *    以便操作系统或硬件进行相应的内存保护和管理。
 *
 * 3. 编译器和汇编器生成的输入节：
 *    编译器和汇编器在生成目标文件时会根据代码和数据的属性创建不同的节（section），
 *    链接器根据这些节的属性将其归类到相应的输出段中。
 *
 * 分段详细说明：
 * 1. .text段（代码段）：
 *    存放程序的机器指令代码。这部分在运行时是只读的，防止程序意外修改自身指令。
 *    特别保留了启动代码部分(.text.boot)，确保启动代码不会被链接器优化掉。
 *
 * 2. .rodata段（只读数据段）：
 *    存放只读数据，例如字符串字面量、const变量等。这些数据在运行时不能被修改。
 *
 * 3. .data段（已初始化数据段）：
 *    存放程序中已初始化的全局变量和静态变量。这些变量在程序开始执行前就具有初始值。
 *
 * 4. .bss段（未初始化数据段）：
 *    存放未初始化的全局变量和静态变量。在程序加载时，这些变量会被自动初始化为0。
 *    通过定义__bss和__bss_end标记，可以在程序初始化时清零这部分内存。
 *
 * 5. 堆和栈：
 *    在.bss段之后预留了1MB空间作为堆空间，用于动态内存分配。
 *    栈顶指针__stack_top标记了栈的顶部位置，栈从高地址向低地址增长。
 *
 * 其他可能存在的段（在此项目中未使用）：
 * 6. .init/.fini段：
 *    存放构造函数和析构函数代码，在C++等语言中用于对象初始化和清理。
 *
 * 7. .plt/.got段：
 *    用于动态链接的位置无关代码，在静态链接的hypervisor中通常不存在。
 *
 * 8. .debug段：
 *    调试信息，如DWARF调试数据，在发布版本中通常被移除。
 *
 * 9. .comment段：
 *    编译器版本信息等注释内容。
 *
 * 10. .eh_frame段：
 *    异常处理帧信息，用于栈展开，在这个简单的hypervisor中被丢弃。
 *
 * 链接器脚本语法说明：
 * 1. SECTIONS命令：
 *    定义了如何组合各个输入节，以及它们在输出文件中的位置和顺序。
 *
 * 2. 位置计数器（.）：
 *    表示当前的虚拟地址，可以被赋值和修改，用于指定各个段的起始地址。
 *
 * 3. 输出节描述：
 *    格式为：section_name : { contents }
 *    其中contents定义了该段包含的内容，*(.section_name)表示包含所有输入文件中的.section_name节。
 *
 * 4. ALIGN(n)：
 *    用于指定地址对齐，确保段按指定字节数对齐。
 *
 * 5. PROVIDE(symbol)：
 *    定义符号的值，常用于提供全局符号，如__bss和__bss_end。
 */

/* 指定程序的入口点为"boot"符号 */
ENTRY(boot)

SECTIONS {
    /* 设置链接地址为0x80200000，这是程序在内存中的起始位置 */
    . = 0x80200000;

    /*
     * .text段 - 代码段
     * 包含程序的所有可执行代码
     */
    .text : {
        /* KEEP(*(.text.boot)) - 保留启动代码部分，确保启动代码不会被优化掉 */
        KEEP(*(.text.boot)); 
        /* 包含其他所有代码部分 */
        *(.text .text.*);
        . = ALIGN(8);
        *(.text.stvec);
    }

    /*
     * .rodata段 - 只读数据段
     * 包含程序中的常量数据，如字符串常量等
     * ALIGN(8) - 按8字节对齐
     */
    .rodata : ALIGN(8) {
        *(.rodata .rodata.*);
    }

    /*
     * .data段 - 已初始化数据段
     * 包含程序中已初始化的全局变量和静态变量
     * ALIGN(8) - 按8字节对齐
     */
    .data : ALIGN(8) {
        *(.data .data.*);
    }

    /*
     * .bss段 - 未初始化数据段
     * 包含程序中未初始化的全局变量和静态变量
     * 这些变量在程序启动时会被初始化为0
     */
    .bss : ALIGN(8) {
         __bss = .;             /* 记录.bss段的起始地址 */
        *(.bss .bss.* .sbss .sbss.*);
        __bss_end = .;          /* 记录.bss段的结束地址 */
    }

    /*
     * 栈和堆的设置
     * 
     * 堆空间：在.bss段之后分配1MB空间用于动态内存分配
     * 栈空间：栈顶指针__stack_top标记了栈的顶部位置
     *        栈从高地址向低地址增长，这是x86-64架构的特点
     * 
     * 注意：根据run.sh脚本，此hypervisor实际运行在RISC-V架构上，
     * 栈的增长方向在RISC-V中同样是从高地址向低地址增长
     */
    . = ALIGN(16);              /* 按16字节对齐 */
    . += 1024 * 1024;           /* 预留1MB空间用于堆(heap) */
    __stack_top = .;            /* 栈顶指针，栈从高地址向低地址增长 */

    __heap = .;
    . += 100 * 1024 * 1024; /* 100MB */
    __heap_end = .;

    /*
     * /DISCARD/ - 丢弃段
     * 指定不需要包含在最终可执行文件中的部分
     * .eh_frame是异常处理相关的帧信息，在这个简单的hypervisor中不需要
     */
    /DISCARD/ : {
        *(.eh_frame);
    }
}